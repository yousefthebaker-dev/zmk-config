## boards/shields/slab50/Kconfig.defconfig
```kconfig
if SHIELD_SLAB50_LEFT

config ZMK_KEYBOARD_NAME
    default "Slab50"

config ZMK_SPLIT_ROLE_CENTRAL
    default y

endif # SHIELD_SLAB50_LEFT

if SHIELD_SLAB50_RIGHT

endif # SHIELD_SLAB50_RIGHT

if SHIELD_SLAB50_DONGLE

config ZMK_KEYBOARD_NAME
    default "Slab50"

config ZMK_SPLIT_ROLE_CENTRAL
    default y

endif # SHIELD_SLAB50_DONGLE

if SHIELD_SLAB50_LEFT || SHIELD_SLAB50_RIGHT || SHIELD_SLAB50_DONGLE

config ZMK_SPLIT
    default y

endif # SHIELD_SLAB50_LEFT || SHIELD_SLAB50_RIGHT || SHIELD_SLAB50_DONGLE
```

## boards/shields/slab50/Kconfig.shield
```kconfig
config SHIELD_SLAB50_LEFT
    def_bool $(shields_list_contains,slab50_left)

config SHIELD_SLAB50_RIGHT
    def_bool $(shields_list_contains,slab50_right)

config SHIELD_SLAB50_DONGLE
    def_bool $(shields_list_contains,slab50_dongle)
```

## boards/shields/t23mx/Kconfig.defconfig
```kconfig
if SHIELD_T23MX_LEFT

config ZMK_KEYBOARD_NAME
    default "Torus23MX"

endif # SHIELD_T23MX_LEFT

if SHIELD_T23MX_RIGHT

config ZMK_KEYBOARD_NAME
    default "Torus23MX"

config ZMK_SPLIT_ROLE_CENTRAL
    default y

endif # SHIELD_T23MX_RIGHT

if SHIELD_T23MX_LEFT || SHIELD_T23MX_RIGHT

config ZMK_SPLIT
    default y

endif # SHIELD_T23MX_LEFT || SHIELD_T23MX_RIGHT
```

## boards/shields/t23mx/Kconfig.shield
```kconfig
config SHIELD_T23MX_LEFT
    def_bool $(shields_list_contains,t23mx_left)

config SHIELD_T23MX_RIGHT
    def_bool $(shields_list_contains,t23mx_right)

config SHIELD_T23MX_DONGLE
    def_bool $(shields_list_contains,t23mx_dongle)
```
